## conf/layer.conf
```bitbake
# We might have a conf and classes directory, append to BBPATH
BBPATH .= ":${LAYERDIR}"

# We have a recipes directory, add to BBFILES
BBFILES += "${LAYERDIR}/recipes*/*/*.bb ${LAYERDIR}/recipes*/*/*.bbappend"

BBFILE_COLLECTIONS += "meta-mcu-rec"
BBFILE_PATTERN_meta-mcu-rec := "^${LAYERDIR}/"
BBFILE_PRIORITY_meta-mcu-rec = "10"
```
